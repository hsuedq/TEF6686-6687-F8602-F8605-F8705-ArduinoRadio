/*
  By Eustake(marsel90)
  With this sketch it is recommended to use together with TEF-GTK v1.1.1 https://github.com/marsel90-1/TEF-GTK_v1.1.1
  Add:
  Fix bug with EQ & iMS when change DX1, DX2, DX3, DX4
  Default tuner front-end AGC is -6db.
  DX1 - set AGC 0dB (fine-tuning of the weak signal handling in high signal conditions)
  DX2 - set AGC -6db (default)
  Apart from AGC obtion DX1 & DX2 use the same settings for TEF.
  Set DX1 for AGC 0db and after change DX3 and DX4 (AGC = 0db)
  Set DX2 for AGC -6db (default) after change DX3 and DX4 (AGC = -6db)
  Without IF+ and RF+ - RF Gain is 0db
  Only RF+ - RF Gain max +6db
  Only IF+ - RF Gain max +10db
  Both IF+ & RF+ - RF Gain max +15db  
  ChannelEqualizer obtion enable/off use TEF-GTK button EQ 
  MphSuppression iMS obtion enable/off use TEF-GTK button iMS 
  TEF6686- Tuner_Patch_Lithio_2.05_patch 5.12
  #
  By VoXiTPro
  RDS PI check, only correct PI codes are send to TEF-GTK. There were a lof of false pi codes.
  used latest version from marsel90.
  #  
  by Eustake (marsel90)
  //With this sketch it is recommended to use together with TEF-GTK v1.1 https://github.com/marsel90-1/TEF-GTK_v1.1
  #
  //TEF6686 lithio 1.02 patch 2.22
  by VoXiTPro
  changes: 
  all warnings are removed  (unsigned int to signed int did go wrong)
  Filters are now switchable (AUTO is max 236khz, manual you can set 311Khz)
  Stereo on/off
  Signal measurement improvements
  Keep filter (to do) and frequency settings when switching from AM to FM / FM to AM
  Settings are now from Eustake (marsel90)
  AGC is now switchable (now for FM/AM and reversed the settings) 
  Removed some settings from Eustake, FMSI stereo improvement only for tef6687 and tef6689, Softmute_mod AM only, Wavegen and I2S audio (only using internal audio)
  You can now change settings with the antenne switch ANT A = default settings, ANT B = Improved settings, ANT C = Eustake Settings
  Settings are now A,B,C from eustake. D are improved settings from prog manual.
  AGC, Deemphasis, IF+ RF+ are now in subroutines so you can set them at other moments. If you change settings the old values will be reapplied.
  IF+ RF+ works now also for AM.
  Squelch will change volume scale for AM.  if you have the right value change the define AM_VOL_SCALE too that value (now -1)
*/  
/*  
 If you have changed the above value squelch will be off again.
 Switching from AM to FM or from FM to AM filter settings are kept
  Thanks also to:
  - FMDXklaas for testing
  - ODJeetje 
  - Eustake for default and improved settings 
  and many others ...
  Tested on Arduino Nano V3.0 at 5V
*/

#include <Wire.h>

#define SERIAL_PORT_SPEED 115200
#define SERIAL_BUFFER_SIZE 16
char buff[SERIAL_BUFFER_SIZE];
uint8_t buff_pos = 0;
uint32_t REG_FREQ;
uint32_t MODA_FREQ = 0;
uint32_t MODF_FREQ = 0;
uint32_t timer = 0;          // Signal level reporting timer
uint32_t timer_DATA = 0;     // DATA reporting timer
int8_t current_filter = -1;  // Current FIR filter (-1 is adaptive)
int8_t current_set = -1;     // Current FIR filter (-1 is adaptive)
int8_t set_filter = 10;      // bij adaptive 236 khz  
int8_t forced_mono;
int16_t LevelOffset;
int16_t Level;
int8_t mode;
int8_t AGC_tress;
int8_t IFplus;
int8_t RFplus;
int8_t Squelch;
int8_t Setsquelch;
int16_t nDeemphasis, volume;
uint32_t freq;
int8_t Filter_AM = 127;
int8_t Filter_FM = 127;

/* Scan */
uint16_t scan_start = 0;
uint16_t scan_end = 0;
uint16_t scan_step = 0;
uint8_t scan_filter = 0;
uint16_t AM_start_scan = 0;
uint16_t AM_scan_end = 0;
uint16_t AM_scan_step = 0;
uint8_t AM_scan_filter = 0;

#define TIMER_INTERVAL 66
#define DATA_TIMER_INTERVAL 87
#define AM_VOL_SCALE -1
#define INIT_FLAG_PATCH1 (0xfeU)
#define INIT_FLAG_PATCH2 (0xfdU)
byte DSP_I2C = 0x64;

int8_t radio_mode;
int8_t scan_mode;

static const uint8_t DSP_INIT[] PROGMEM =
{
  0x19, 0x1B, 0xF0, 0x00, 0x60, 0x40, 0xD0, 0x80, 0x20, 0x87, 0x60, 0x4C, 0xD0, 0x80, 0x90, 0x00, 0x60, 0x4E, 0xD0, 0x80, 0x22, 0x02, 0x00, 0x55, 0x60, 0x04, 
  0x19, 0x1B, 0xF0, 0x00, 0x60, 0x65, 0xDF, 0x80, 0xF0, 0x00, 0x05, 0xBA, 0x60, 0x0E, 0x20, 0x90, 0x60, 0x9B, 0xD0, 0x80, 0x31, 0x40, 0x60, 0x9F, 0xD0, 0x80, 
  0x19, 0x1B, 0x9E, 0xB9, 0x60, 0xAD, 0xD0, 0x80, 0xF0, 0x00, 0x60, 0xAF, 0xD0, 0x80, 0x20, 0x15, 0x60, 0xB3, 0xD2, 0x80, 0xF0, 0x00, 0x60, 0xCE, 0xD0, 0x80, 
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  0x03, 0x1C, 0x00, 0x74,                                           // Set Required Initialization Control(1)  
  0x01, INIT_FLAG_PATCH1,                                           // Load Required Initialization(s)....//Beginning of LutByteValues
  0x19, 0x1B, 0x80, 0x17, 0x80, 0x45, 0x80, 0x96, 0x81, 0x5B, 0x82, 0xD6, 0x83, 0x76, 0x88, 0x0B, 0x88, 0x10, 0x88, 0xDB, 0x89, 0x48, 0x89, 0xE9, 0x8B, 0x0A, 
  0x19, 0x1B, 0x8B, 0x12, 0x8B, 0x13, 0x8B, 0x21, 0x8B, 0x26, 0x8C, 0x6F, 0x8F, 0x91, 0x8F, 0xF6, 0x94, 0xD0, 0x95, 0x20, 0x95, 0x33, 0x95, 0x6F, 0x95, 0xA8, 
  0x19, 0x1B, 0x95, 0xAC, 0x95, 0xC3, 0x95, 0xE1, 0x97, 0xC9, 0x97, 0xF6, 0x98, 0x8D, 0x99, 0x00, 0x9A, 0x00, 0x9E, 0x73, 0xA0, 0x12, 0xA1, 0x03, 0xA1, 0x68, 
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  0x03, 0x1C, 0x00, 0x75,                                           // Set Required Initialization Control(2)
  0x01, INIT_FLAG_PATCH2,                                           // Load Required Initialization(s)....
  0x03, 0x1C, 0x00, 0x00,                                           // Clear Required Initialization Control
  0x03, 0x14, 0x00, 0x01,                                           // Start Firmware....
  0x02, 0xFF, 50,                                                   // Wait 50 ms
  0x09, 0x40, 0x04, 0x01, 0x00, 0x8C, 0xA0, 0x00, 0x00, 0x00,       // 9216 MHz crystal reference
  //0x09, 0x40, 0x04, 0x01, 0x00, 0x3D, 0x09, 0x00, 0x00, 0x00,       // 4000 MHz crystal reference
  0x05,0x40,0x05,0x01,0x00,0x01,                                    // Command APPL_Activate will bring the device into ‘active state’ = radio standby
  0x02,0xFF,100,                                                    // Wait 100 ms
  0x05, 0x20, 0x14, 0x01, 0x00, 0x01,                                                                          // FM 20 Set_MphSuppression         (1, 1)
  0x05, 0x20, 0x16, 0x01, 0x00, 0x01,                                                                          // FM 22 Set_ChannelEqualizer       (1, 1) 
};

static const uint8_t INIT_DX1[] PROGMEM =
{
 /*FM_add_and_improved_settings by eustake*/                                                                     
  0x07, 0x20, 0x17, 0x01, 0x00, 0x01, 0x03, 0xE8,                                                              // FM 23 Set_NoiseBlanker           (1, 1, 1000)
  0x09, 0x20, 0x18, 0x01, 0x01, 0x2C, 0x01, 0x2C, 0x00, 0xFA,                                                  // FM 24 Set_NoiseBlanker_Options   (1, 300, 300, 250)
  0x11, 0x20, 0x26, 0x01, 0x00, 0x00, 0x00, 0x00, 0x00, 0x00, 0x00, 0x00, 0x00, 0x00, 0x00, 0x00, 0x00, 0x00,  // FM 38 Set_LevelStep                 
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  0x0B, 0x20, 0x5B, 0x01, 0x05, 0xDC, 0x05, 0xDC, 0x05, 0xDC, 0x05, 0xDC,                                      // FM_Set_StBandBlend_Gain          (1, 1500, 1500, 1500, 1500)
   /*AM_add_settings by eustake*/
  0x07, 0x21, 0x0A, 0x01, 0x00, 0x01, 0x00, 0x1E,                                                              // AM_Set_Bandwidth              (1, 1, 30)
  0x05, 0x21, 0x0B, 0x01, 0x03, 0xFC,                                                                          // AM_Set_RFAGC                  (1, 1020)                                                          
  0x0B, 0x21, 0x0E, 0x01, 0x00, 0x01, 0x00, 0x02, 0x04, 0xB0, 0x00, 0x03,                                      // AM_Set_CoChannelDet           (1, 1, 2, 1200, 3)
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  0x07, 0x21, 0x3A, 0x01, 0x00, 0x01, 0x00, 0x1E,                                                              // AM_Set_Lowcut_Min             (1, 1, 30)  
  /*Audio*/
  0x07, 0x30, 0x0D, 0x01, 0x00, 0x11, 0x00, 0xF0,                                                              // AUDIO_Set_Output_Source
  0
};

static const uint8_t INIT_DX2[] PROGMEM =
{
  /*FM_add_and_improved_settings by eustake*/                                                                            
  0x07, 0x20, 0x17, 0x01, 0x00, 0x01, 0x03, 0xE8,                                                              // FM 23 Set_NoiseBlanker           (1, 1, 1000)
  0x09, 0x20, 0x18, 0x01, 0x01, 0x2C, 0x01, 0x2C, 0x00, 0xFA,                                                  // FM 24 Set_NoiseBlanker_Options   (1, 300, 300, 250)
  0x11, 0x20, 0x26, 0x01, 0xFF, 0xEC, 0xFF, 0xE2, 0xFF, 0xD8, 0xFF, 0xCE, 0xFF, 0xC4, 0xFF, 0xC4, 0xFF, 0xC4,  // FM 38 Set_LevelStep                   
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  0x0B, 0x20, 0x5B, 0x01, 0x05, 0xDC, 0x05, 0xDC, 0x05, 0xDC, 0x05, 0xDC,                                      // FM_Set_StBandBlend_Gain          (1, 1500, 1500, 1500, 1500)
  /*AM_add_settings by eustake*/
  0x05, 0x21, 0x0B, 0x01, 0x03, 0xFC,                                                                          // AM_Set_RFAGC (1, 1020)                                                          
  0x0B, 0x21, 0x0E, 0x01, 0x00, 0x01, 0x00, 0x02, 0x04, 0xB0, 0x00, 0x03,                                      // AM_Set_CoChannelDet (1, 1, 2, 1200, 3)
  0x07, 0x21, 0x17, 0x01, 0x00, 0x01, 0x04, 0xB0,                                                              // AM_Set_NoiseBlanker (1, 1, 1200)       
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  0x07, 0x21, 0x3A, 0x01, 0x00, 0x01, 0x00, 0x1E,                                                              // AM_Set_Lowcut_Min (1, 1, 30)
  /*Audio*/
  0x07, 0x30, 0x0D, 0x01, 0x00, 0x11, 0x00, 0xF0,                                                              // AUDIO_Set_Output_Source
  0
};

static const uint8_t INIT_DX3[] PROGMEM =
{
 /*TEF6686_add_and_improved_settings by eustake*/
  0x07, 0x20, 0x17, 0x01, 0x00, 0x01, 0x03, 0xE8,                                                              // FM 23 Set_NoiseBlanker           (1, 1, 1000) 
  0x09, 0x20, 0x18, 0x01, 0x01, 0x2C, 0x01, 0x2C, 0x00, 0xFA,                                                  // FM 24 Set_NoiseBlanker_Options   (1, 300, 300, 250)
  0x0B, 0x20, 0x28, 0x01, 0x00, 0x78, 0x01, 0xF4, 0x00, 0x0A, 0x00, 0x14,                                      // FM 40 Set_Softmute_Time          (1, 120, 500, 10, 20)   
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  0x07, 0x30, 0x0D, 0x01, 0x00, 0x80, 0x00, 0xE0,                                                              // AUDIO_Set_Output_Source          (1, 128, 224)
  /*AM_add_settings by eustake*/
  0x05, 0x21, 0x0B, 0x01, 0x03, 0xFC,                                                                          // AM_Set_RFAGC (1, 1020)                                                          
  0x0B, 0x21, 0x0E, 0x01, 0x00, 0x01, 0x00, 0x02, 0x04, 0xB0, 0x00, 0x03,                                      // AM_Set_CoChannelDet (1, 1, 2, 1200, 3)
  0x07, 0x21, 0x17, 0x01, 0x00, 0x01, 0x04, 0xB0,                                                              // AM_Set_NoiseBlanker (1, 1, 1200)       
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  0x07, 0x21, 0x3A, 0x01, 0x00, 0x01, 0x00, 0x1E,                                                              // AM_Set_Lowcut_Min (1, 1, 30)
  /*Audio*/
  0x07, 0x30, 0x0D, 0x01, 0x00, 0x11, 0x00, 0xF0,                                                              // AUDIO_Set_Output_Source
  0
};

static const uint8_t INIT_DX4[] PROGMEM =
{
  /*TEF6686_add_and_improved_settings by voxit*/
  0x07, 0x20, 0x17, 0x01, 0x00, 0x01, 0x03, 0xE8,                                                             // FM 23 Set_NoiseBlanker         (1, 1, 1000)                           default
  0x09, 0x20, 0x18, 0x01, 0x00, 0xD2, 0x00, 0xD2, 0x00, 0xFA,                                                 // FM 24 Set_NoiseBlanker_Options (1, 210, 210, 250)                     default 
  0x05, 0x20, 0x1F, 0x01, 0x01, 0xF4,                                                                         // FM 31 Set_Deemphasis           (1, 500)                               default
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  0x05, 0x20, 0x56, 0x01, 0x03, 0x84,                                                                         // FM 86 Set_Bandwidth_Options    (1, 900)
  /*AM_add_settings by eustake*/
  0x07, 0x21, 0x0A, 0x01, 0x00, 0x01, 0x00, 0x1E,                                                              // AM_Set_Bandwidth (1, 1, 30)
  0x05, 0x21, 0x0B, 0x01, 0x03, 0xFC,                                                                          // AM_Set_RFAGC (1, 1020)                                                          
  0x0B, 0x21, 0x0E, 0x01, 0x00, 0x01, 0x00, 0x02, 0x04, 0xB0, 0x00, 0x03,                                      // AM_Set_CoChannelDet (1, 1, 2, 1200, 3)
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  0x07, 0x21, 0x3A, 0x01, 0x00, 0x01, 0x00, 0x1E,                                                              // AM_Set_Lowcut_Min (1, 1, 30)
  /*Audio*/
  0x07, 0x30, 0x0D, 0x01, 0x00, 0x11, 0x00, 0xF0,                                                              // AUDIO_Set_Output_Source
  0
};

const uint16_t FMFilterMap[32] PROGMEM = { 560, 640, 720, 840, 970, 1140, 1330, 1510, 1680, 1840, 2000, 2170, 2360, 2540, 2870, 3110, 560, 560, 560, 560, 560, 560, 560, 560, 560, 0, 640, 0, 840, 970, 0, 560 };
const uint8_t AMFilterMap[32] PROGMEM = { 30, 30, 30, 30, 40, 40, 40, 40, 60, 60, 60, 60, 80, 80, 80, 80 };

void Write(uint8_t *buf, uint8_t len)
{
  Wire.beginTransmission(DSP_I2C);
  for (int i = 0; i < len; i++)
    Wire.write(*buf++);
  Wire.endTransmission();
}

void Read(uint8_t *buf, uint8_t len)
{
  uint8_t lenrec = Wire.requestFrom(DSP_I2C, len);
  for (int i = 0; i < lenrec; i++)
    *buf++ = Wire.read();
}

void Set_Cmd(uint8_t mdl, uint8_t cmd, int len, ...)
{
  uint8_t buf[31];
  uint16_t temp;
  va_list vArgs;
  va_start(vArgs, len);
  buf[0] = mdl;
  buf[1] = cmd;
  buf[2] = 1;
  for (uint8_t i = 0; i < len; i++)
  {
    temp = va_arg(vArgs, uint16_t);
    buf[3 + i * 2] = (uint8_t)(temp >> 8);
    buf[4 + i * 2] = (uint8_t)temp;
  }
  va_end(vArgs);
  Write(buf, len * 2 + 3);
}

void Get_Cmd(uint8_t mdl, uint8_t cmd, int16_t *receive, int len)
{
  uint8_t buf[3];
  buf[0] = mdl;
  buf[1] = cmd;
  buf[2] = 1;
  Write(buf, 3);
  Read((uint8_t*)receive, 2 * len);
  for (uint8_t i = 0; i < len; i++)
  {
    uint16_t newval = (uint8_t)(receive[i] >> 8) | (((uint8_t)(receive[i])) << 8);
    receive[i] = newval;
  }
}

void dsp_write_data(const uint8_t* data)
{
  uint8_t *pa = (uint8_t *)data;
  uint8_t len, i, first;
  for (;;)
  {
    len = pgm_read_byte_near(pa++);
    first = pgm_read_byte_near(pa);
    if (!len)
      break;
    if (len == 2 && first == 0xff)
    {
      int delaytime = pgm_read_byte_near(++pa);
      delay(delaytime);
      pa++;
    }
    else
    {
      Wire.beginTransmission(DSP_I2C);
      for (int i = 0; i < len; i++)
        Wire.write(pgm_read_byte_near(pa++));
      Wire.endTransmission();
    }
  }
}

void scan(bool continous)
{

  uint32_t freq;
  uint32_t buffer;

  if ( scan_start < 6500 )
  {
    scan_mode = 1;
    scan_start = AM_start_scan;
    scan_end = AM_scan_end;
    scan_step = AM_scan_step;
  }
  else
  {
    scan_mode = 0;
  }

  if (scan_mode == 0)
  {
    if (scan_filter == -1) {set_filter = 10;} else {set_filter = scan_filter;}
    Set_Cmd(32, 10, 4, scan_filter == -1 ? 1 : 0, pgm_read_word_near(FMFilterMap + set_filter), 1000, 1000);
    Set_Cmd(32, 1, 2, 1, scan_start);
  }
  else
  {
    Set_Cmd(33, 10, 2, scan_filter == -1 ? 1 : 0, pgm_read_byte_near(AMFilterMap + scan_filter));
    Set_Cmd(33, 1, 2, 1, scan_start);
  }
  do
  {
    Serial.print('U');
    for (freq = scan_start; freq <= scan_end; freq += scan_step)
    {
      Set_Cmd( scan_mode == 0 ? 32 : 33, 1, 2, 1, freq);
      Serial.print(scan_mode == 0 ? freq * 10 : freq, DEC);
      Serial.print('=');
      delay(10);

      int16_t uQuality[4] = { 0 };
      Get_Cmd(scan_mode == 0 ? 32 : 33, 128, uQuality, 4);
      Serial.print(uQuality[1] / 10, DEC);
      Serial.print(',');
    }

    Serial.print('\n');
  } while (continous && !Serial.available());
  //  Restore previous settings
  if (radio_mode == 0)
  {
    if (current_filter == -1) {set_filter = 10;} else {set_filter = current_filter;}
    Set_Cmd( 32, 10, 4, current_filter == -1 ? 1 : 0, pgm_read_word_near(FMFilterMap + set_filter), 1000, 1000);
    Set_Cmd( 32, 1, 2, 1, REG_FREQ / 10 );
  }
  else
  {
    Set_Cmd( 33, 10, 2, 0, pgm_read_byte_near(AMFilterMap + current_filter));
    Set_Cmd( 33, 1, 2, 1, REG_FREQ );
  }
}

void get_DATA()
{
  int16_t uDATA_Data[8] = {0};
  Get_Cmd(32, 131, uDATA_Data, 8);
  if ( bitRead(uDATA_Data[0], 15) == 1 )
  {
    if ((uDATA_Data[5] >> 14) == 0) { 
      Serial.print('P');
      serial_hex(uDATA_Data[1] >> 8);
      serial_hex(uDATA_Data[1]);
      Serial.print('\n');
    };
    Serial.print('R');
    serial_hex(uDATA_Data[2] >> 8);
    serial_hex(uDATA_Data[2]);
    serial_hex(uDATA_Data[3] >> 8);
    serial_hex(uDATA_Data[3]);
    serial_hex(uDATA_Data[4] >> 8);
    serial_hex(uDATA_Data[4]);
    serial_hex(uDATA_Data[5] >> 8);
    Serial.print('\n');
  }
}

void serial_hex(uint8_t val)
{
  Serial.print((val >> 4) & 0xF, HEX);
  Serial.print(val & 0xF, HEX);
}

void Set_AGC_tresshold(uint8_t val)
{
 if (val == 0) {
  Set_Cmd(32, 11, 1, 920, 0);
  Set_Cmd(33, 11, 1, 1020);  
 } else if (val == 1) {
  Set_Cmd(32, 11, 1, 890, 0);
  Set_Cmd(33, 11, 1, 990);
 } else if (val == 2) {
  Set_Cmd(32, 11, 1, 870, 0);
  Set_Cmd(33, 11, 1, 970);
 } else {
  Set_Cmd(32, 11, 1, 840, 0);
  Set_Cmd(33, 11, 1, 940);
 }
}

void Set_IF_RF(uint8_t val, uint8_t val1)
{
  if (val == 1 && val1 == 0) {
     Set_Cmd(32, 39, 1, 60);
     Set_Cmd(33, 39, 1, 60);
  } else if (val == 0 && val1 == 1) {
     Set_Cmd(32, 39, 1, 100);
     Set_Cmd(33, 39, 1, 60);
  } else if (val == 1 && val1 == 1) {
     Set_Cmd(32, 39, 1, 150);
     Set_Cmd(33, 39, 1, 120);
  } else {
     Set_Cmd(32, 39, 1, 0);
     Set_Cmd(33, 39, 1, 0);
  }
}

void Set_Deempasis(uint8_t val)
{
  if (val == 0) { 
    Set_Cmd(32, 31, 1, 500);
  } else  if (val == 1) {
    Set_Cmd(32, 31, 1, 750);
  } else if (val == 2) {
    Set_Cmd(32, 31, 1, 0);
  }
}

void setup()
{
  Wire.begin();
  Serial.begin(115200);
  delay(40);
  int16_t uState;
  Get_Cmd(64, 128, &uState, 1);
  if (uState < 2)
    dsp_write_data(DSP_INIT);
  else if (uState > 2)
  {
    Set_Cmd(64, 1, 1, 1);
  }
  
  while (true)
  {
    if (Serial.available() > 0)
    {
      if (Serial.read() == 'x')
      {
        while (!Serial.available());
        if (Serial.read() == '\n')
          break;
      }
    }
  }
  delay(20);
  while (Serial.available() > 0)
    Serial.read();  // clear the serial buffer
  Serial.print("\nOK\n");
  if (AM_VOL_SCALE != -1) {
    int SetVolScale = map(AM_VOL_SCALE, 0, 100, -120, 60);
    Set_Cmd(33, 80, 1, SetVolScale);
  }
}

void loop()
{
  // check signal level and 19kHz subcarrier every TIMER_INTERVAL
  if ((millis() - timer) >= TIMER_INTERVAL)
  {
    Serial.print("S");
    if (radio_mode == 0){
      int16_t uStatus;
      Get_Cmd(32, 133, &uStatus, 1);
      if (forced_mono == 1){
        Serial.print('M');} 
      else { 
        char stereo = (uStatus & (1 << 15)) ? 's' : 'm';
        Serial.print(stereo);}
    }
    else {
      Serial.print('m');}
    int16_t uQuality[4] = { 0 };
    if (radio_mode == 0){
      Get_Cmd(32, 128, uQuality, 6);}
    else {
      Get_Cmd(33, 128, uQuality, 4);}
    if (uQuality[1] > 1200){uQuality[1] = 1200;}  // Schiet soms ver door zo begrenst tot max waarde datasheet
    Serial.print(uQuality[1] / 10, DEC);
    Serial.print(',');
    if ((uQuality[2] > 1000) && (radio_mode ==0)) {uQuality[2] = 1000;}  // Schiet soms boven de 1000 in datasheet is echter max wel 1000 
    if (radio_mode ==1){uQuality[2] = uQuality[2] / 5;}                  // voor am max 500% terugzet naar 100% 
    Serial.print(uQuality[2] / 10, DEC);
    Serial.print(',');
    Serial.print(uQuality[3] / 10, DEC);
    Serial.print('\n');
     timer = millis();}

  if (radio_mode == 0) {
    if ((millis() - timer_DATA) >= DATA_TIMER_INTERVAL)
    {
      get_DATA();
      timer_DATA = millis();
    }
  }

  if (Serial.available() > 0)
  {
    buff[buff_pos] = Serial.read();
    if (buff[buff_pos] != '\n' && buff_pos != SERIAL_BUFFER_SIZE - 1)
      buff_pos++;
    else {
      buff[buff_pos] = 0x00;
      buff_pos = 0;

      switch (buff[0])
      {

        case 'x':
          Serial.println("OK");
          break;

         case 'Y':  // Audio volume scaler
        volume = atoi(buff + 1);
        if(volume == 0){
          Set_Cmd(48, 11, 1, 1);//mute
        } else {
          Set_Cmd(48, 11, 1, 0);//unmute
          Set_Cmd(48, 10, 1, volume * 7 - 650);
        }
        Serial.print("Y");
        Serial.println(volume);
        break;
        
        case 'S':
          if (buff[1] == 'a')
          {
            scan_start = (atol(buff + 2) + 5) / 10;
            AM_start_scan = atol(buff + 2);
          }
          else if (buff[1] == 'b')
          {
            scan_end = (atol(buff + 2) + 5) / 10;
            AM_scan_end = atol(buff + 2);
          }
          else if (buff[1] == 'c')
          {
            scan_step = (atol(buff + 2) + 5) / 10;
            AM_scan_step = atol(buff + 2);
          }
          else if (buff[1] == 'f')
          {
            scan_filter = atol(buff + 2);
          }
          else if (scan_start > 0 && scan_end > 0 && scan_step > 0 && scan_filter >= 0)
          {
            if (buff[1] == 'm')
              scan(true);   // Multiple (continous) scan
            else
              scan(false);  // Single scan
          }
          break;
          
        case 'B':
          forced_mono = atol(buff + 1);
          if(forced_mono == 1)
          Set_Cmd(32, 66, 1, 2, forced_mono == 1 ? 2 : 0 , 200);
          else 
          Set_Cmd(32, 66, 1, 0, forced_mono == 1 ? 2 : 0 , 400);   
          Serial.print('B');
          Serial.print(forced_mono ? '1' : '0');
          Serial.print('\n');
          break;       
        case 'N':
          break;
        
        case 'M':
          mode = atol(buff + 1);
          if (mode == 0){  
            if (MODF_FREQ == 0){MODF_FREQ = 87500;} 
            Set_Cmd(32, 1, 2, 1, MODF_FREQ / 10);
            Serial.println("M0");
            Serial.print('T');
            Serial.println(MODF_FREQ);
            if (Filter_AM != 127) {Filter_AM = current_filter;} 
			      if (Filter_FM == 127) {Filter_FM = -1;}
			      current_filter = Filter_FM;
            Set_Cmd(32, 10, 4, current_filter == -1 ? 1 : 0, pgm_read_word_near(FMFilterMap + current_filter), 1000, 1000);
            radio_mode = 0;
          } else {
            if (MODA_FREQ == 0){MODA_FREQ = 522;} 
            Set_Cmd(33, 1, 2, 1, MODA_FREQ);
            Serial.println("M1");
            Serial.print('T');
            Serial.println(MODA_FREQ);
			      Filter_FM = current_filter;
	          if (Filter_FM != 127) {Filter_FM = current_filter;} 
   	        if (Filter_AM == 127) {Filter_AM = 21;}
            current_filter = Filter_AM;
            Set_Cmd(33, 10, 2, 0, pgm_read_byte_near(AMFilterMap + current_filter));
            radio_mode = 1;
          }
          Serial.print('F');
          Serial.println(current_filter);
          Serial.print('V');
          Serial.println(LevelOffset);
          break;
                 
        case 'T':  // Tune to a frequency (to do keep filter settings)
          freq = atol(buff + 1);
          REG_FREQ = freq;
          if ((REG_FREQ >= 65000) && (REG_FREQ <= 108000)) {
            Set_Cmd(32, 1, 2, 1, REG_FREQ / 10);
            Serial.println("M0");
            Serial.print('T');
            Serial.println(REG_FREQ);
            if (radio_mode == 1) {                         // from AM to FM then switch to adaptive filter AUTO in xdr-gtk
              if (Filter_AM != 127) {Filter_AM = current_filter;} 
			        if (Filter_FM == 127) {Filter_FM = -1;}
			        current_filter = Filter_FM;
              Set_Cmd(32, 10, 4, current_filter == -1 ? 1 : 0, pgm_read_word_near(FMFilterMap + current_filter), 1000, 1000);
            }
            radio_mode = 0;
            MODF_FREQ = REG_FREQ;
          } else if ((REG_FREQ >= 144) && (REG_FREQ <= 26999)) {
              Set_Cmd(33, 1, 2, 1, REG_FREQ);
              Serial.println("M1");
              Serial.print('T');
              Serial.println(REG_FREQ);
              if (radio_mode == 0) {                       // from FM to AM then use filter 21 3,9khz 4khz   
                if (Filter_FM != 127) {Filter_FM = current_filter;} 
				        if (Filter_AM == 127) {Filter_AM = 21;}
                current_filter = Filter_AM;
                Set_Cmd(33, 10, 2, 0, pgm_read_byte_near(AMFilterMap + current_filter));
              }
              radio_mode = 1;
              MODA_FREQ = REG_FREQ;
          } 
          Serial.print('F');
          Serial.println(current_filter);
          Serial.print('V');
          Serial.println(LevelOffset);
          break;

        case 'F':  // Change FIR filters
          current_filter = atoi(buff + 1);
          if (radio_mode == 0) {
            if (current_filter == -1) {set_filter = 10;} else {set_filter = current_filter;}
            Set_Cmd(32, 10, 4, current_filter == -1 ? 1 : 0, pgm_read_word_near(FMFilterMap + current_filter), 1000, 1000);
          }
          else {
            Set_Cmd(33, 10, 2, 0, pgm_read_byte_near(AMFilterMap + current_filter));
          }
          Serial.print('F');
          Serial.println(buff + 1);
          break;
        
        case 'V':      // Set AM lna (in XDR-GTK enable Show antenna input alignment) (NO FM)
          LevelOffset = atoi(buff + 1);
          Level = map(LevelOffset, 0, 127, 0, 360);
          if (radio_mode == 1) {Set_Cmd(33, 12, 1, Level);}
          Serial.print('V');
          Serial.println(buff + 1);
          break;
          
        case 'Q':  // Audio volume scaler
          Squelch = atoi(buff + 1);
          if (Squelch != -1 && AM_VOL_SCALE == -1) {
            int Setsquelch = map(Squelch, 0, 100, -120, 60);
            Set_Cmd(33, 80, 1, Setsquelch);
            Serial.print("Q");
            Serial.println(Squelch);
          } 
          break;
         
        case 'D':  // Change the de-emphasis
          nDeemphasis = atoi(buff + 1);
          Serial.print("D");
          Set_Deempasis(nDeemphasis);
          Serial.println(nDeemphasis);
          break;

        case 'G':
          Serial.print('G');
          RFplus = buff[1] - 48;
          IFplus = buff[2] - 48;
          Set_IF_RF(RFplus,IFplus);
          Serial.print(RFplus);
          Serial.println(IFplus);
          break;

        case 'A':  // AGC  (check what levelstepping does)
          Serial.print('A');
          AGC_tress = atoi(buff + 1);
          Set_AGC_tresshold(AGC_tress);
          Serial.println(AGC_tress);
          break;

        case 'C':
         byte ChEq_iMS;
         ChEq_iMS = atol(buff + 1);
         Serial.print("C");
         if (ChEq_iMS == 0) {   
         Set_Cmd(32, 22, 1, 1);  //ChannelEqualizer 1
         Set_Cmd(32, 20, 1, 1);  //MphSuppression 1
         Serial.print("1\n");
         Serial.print("C0\n");
         Serial.print("\n");
         }
         if (ChEq_iMS == 1) {
          Set_Cmd(32, 22, 1, 0); //ChannelEqualizer 0
          Serial.print("1\n");
          Serial.print("\n");
         }
         if (ChEq_iMS == 2) {
          Set_Cmd(32, 20, 1, 0);  //MphSuppression 0
         Serial.print("2\n");
         Serial.print("\n");
         }
       break;
         
        case 'Z':
          Serial.print('Z');
          if (buff[1] == '0') {
              dsp_write_data(INIT_DX1);
            Serial.print("0");
          } else if (buff[1] == '1') {
              dsp_write_data(INIT_DX2);
            Serial.print("1");
          } else if (buff[1] == '2') {
              dsp_write_data(INIT_DX3);
            Serial.print("2");
          } else if (buff[1] == '3') {
              dsp_write_data(INIT_DX4);
            Serial.print("3");
          } else {
            Serial.print("4");
          }
          Serial.print('\n');
          Set_AGC_tresshold(AGC_tress);
          Set_IF_RF(RFplus,IFplus);
          Set_Deempasis(nDeemphasis);
          break;

       
        case 'X':  // shutdown
          Set_Cmd(64, 1, 1, 1);
          TWCR = 0;  // Release SDA and SCL lines used by hardware I2C
          Serial.println("X");
          delay(10);
          asm("jmp 0");
          break;
      }
    }
  }
}
